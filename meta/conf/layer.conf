## meta/conf/layer.conf
```bitbake
# LAYER.conf

# Use in BBLAYERS.CONF following poky/meta and poky/meta-poky
# such that the prepend places this layer at the front of BBPATH

BBPATH =. "${LAYERDIR}:"

BBFILES += " \
${LAYERDIR}/recipes-*/*/*.bb \
${LAYERDIR}/recipes-*/*/*.bbappend \
"

BBFILE_COLLECTIONS += "distro-manifest"
BBFILE_PATTERN_distro-manifest = "^${LAYERDIR}/"
BBFILE_PRIORITY_distro-manifest = "12"

# Requied dependency layers that are present in every build
LAYERDEPENDS_distro-manifest = "core yocto"
LAYERSERIES_COMPAT_distro-manifest = "kirkstone scarthgap"

# ---
```
